## sdkconfig.defaults
```kconfig
#
# Partition Table
#
CONFIG_PARTITION_TABLE_CUSTOM=y
CONFIG_PARTITION_TABLE_CUSTOM_FILENAME="partitions.csv"
CONFIG_PARTITION_TABLE_FILENAME="partitions.csv"
CONFIG_PARTITION_TABLE_OFFSET=0x8000
CONFIG_PARTITION_TABLE_MD5=y
# end of Partition Table

CONFIG_ESP_SYSTEM_EVENT_TASK_STACK_SIZE=4096

#
# Zboss
#
CONFIG_ZB_ENABLED=y
CONFIG_ZB_ZCZR=y
# end of Zboss
# end of Component config

# Custom configs for esp32c6 running both Wifi and Zigbee
CONFIG_ESP_COEX_SW_COEXIST_ENABLE=y
CONFIG_ZB_RADIO_NATIVE=y

CONFIG_EXAMPLE_WIFI_SSID="Patty"
CONFIG_EXAMPLE_WIFI_PASSWORD="chakra7777777"
```
